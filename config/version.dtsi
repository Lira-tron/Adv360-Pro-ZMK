#define VERSION_MACRO
macro_ver: macro_ver {
compatible = "zmk,behavior-macro";
label = "macro_ver";
#binding-cells = <0>;
bindings = <&kp N2>, <&kp N0>, <&kp N2>, <&kp N4>, <&kp N0>, <&kp N5>, <&kp N1>, <&kp N7>, <&kp MINUS>, <&kp V>, <&kp N3>, <&kp DOT>, <&kp N0>, <&kp MINUS>, <&kp A>, <&kp N0>, <&kp N3>, <&kp B>, <&kp N6>, <&kp N4>, <&kp B>, <&kp RET>;
};
